## fundamentals/linux/06-kernel-build-boot/fixtures/configs/multi_v7_defconfig
```kconfig
# Baseline multi_v7_defconfig excerpt for Linux 6.18.50 LTS
CONFIG_ARM=y
CONFIG_SYS_SUPPORTS_APM_EMULATION=y
CONFIG_HAVE_PROC_CPU=y
CONFIG_STACKTRACE_SUPPORT=y
CONFIG_LOCKDEP_SUPPORT=y
CONFIG_ARCH_HAS_BANDGAP=y
CONFIG_GENERIC_HWEIGHT=y
CONFIG_GENERIC_CALIBRATE_DELAY=y
CONFIG_NEED_DMA_MAP_STATE=y
CONFIG_ARCH_SUPPORTS_UPROBES=y
CONFIG_ARM_PATCH_PHYS_VIRT=y
CONFIG_GENERIC_BUG=y
CONFIG_DEFCONFIG_LIST="/lib/modules/$UNAME_RELEASE/.config"
CONFIG_ARCH_VIRT=y
CONFIG_ARCH_MULTI_V7=y
CONFIG_CPU_V7=y
CONFIG_CPU_32v7=y
CONFIG_SMP=y
CONFIG_ARM_GIC=y
CONFIG_PRINTK=y
CONFIG_PRINTK_TIME=y
CONFIG_TTY=y
CONFIG_VT=y
CONFIG_CONSOLE_TRANSLATIONS=y
CONFIG_VT_CONSOLE=y
CONFIG_HW_CONSOLE=y
CONFIG_SERIAL_AMBA_PL011=y
CONFIG_SERIAL_AMBA_PL011_CONSOLE=y
CONFIG_EXT4_FS=y
```

## fundamentals/linux/10-shallow-buildroot/fixtures/br2-external/package/appliance-diag/Config.in
```kconfig
config BR2_PACKAGE_APPLIANCE_DIAG
	bool "appliance-diag"
	help
	  Original Phase 3 diagnostic utility.  It reports the kernel release,
	  the appliance identity marker installed by the root filesystem overlay,
	  and the device tree model string exposed by the kernel.

	  Used by P3-M06 to exercise Buildroot's package build-stamp semantics.
```
